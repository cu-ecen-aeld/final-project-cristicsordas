## base_external/Config.in
```kconfig
source "$BR2_EXTERNAL_assignment_base_PATH/package/raspi-robot/Config.in"
source "$BR2_EXTERNAL_assignment_base_PATH/package/pca-driver/Config.in"
```

## base_external/package/pca-driver/Config.in
```kconfig
config BR2_PACKAGE_PCA_DRIVER
	bool "pca-driver"
	help
	  Includes the pca 9685 driver
```

## base_external/package/pcf-driver/Config.in
```kconfig
config BR2_PACKAGE_PCF_DRIVER
	bool "pcf-driver"
	help
	  Includes the pcf 8591 driver
```

## base_external/package/raspi-robot/Config.in
```kconfig
config BR2_PACKAGE_RASPI_ROBOT
	bool "raspi-robot"
	help
	  Includes the controlling socket server application 
```
